## config/boards/shields/ergonaut/Kconfig.shield
```kconfig
# No whitespace after the comma or in the keyboard name!
config SHIELD_ERGONAUT_ONE_LEFT
    def_bool $(shields_list_contains,ergonaut_one_left)

config SHIELD_ERGONAUT_DONGLE
    def_bool $(shields_list_contains,ergonaut_dongle)

config SHIELD_ERGONAUT_ONE_RIGHT
    def_bool $(shields_list_contains,ergonaut_one_right)
    
```

## config/boards/shields/ergonaut_one/Kconfig.defconfig
```kconfig
if SHIELD_ERGONAUT_DONGLE

# Max 16 characters in keyboard name
config ZMK_KEYBOARD_NAME
    default "Ergonaut One"

config ZMK_SPLIT_ROLE_CENTRAL
    default y

# Set this to the number of peripherals your dongle will have.
# For a unibody, this would be 1. If you have left and right halves, set it to 2, etc.
config ZMK_SPLIT_BLE_CENTRAL_PERIPHERALS
    default 2

config ZMK_SPLIT
	default y

endif
```

## config/west.yml
```yaml
manifest:
    remotes:
        - name: zmkfirmware
          url-base: https://github.com/zmkfirmware
        - name: janpfischer
          url-base: https://github.com/janpfischer
        - name: Xeanloo
          url-base: https://github.com/Xeanloo
    projects:
        - name: zmk
          remote: zmkfirmware
          revision: main
          import: app/west.yml
        # - name: zmk-dongle-screen
        #   remote: janpfischer
        #   revision: main
        - name: zmk-dongle-screen
          remote: Xeanloo
          revision: last_words
        # - name: prospector-zmk-module
        #   remote: Xeanloo
        #   revision: main
    self:
        path: config
```
